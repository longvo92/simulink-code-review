AUTOSAR XML (schema 4.0)
package /Interfaces
  sender receiver interface If_Speed
    data Speed
  sender receiver interface If_Torque
    data Torque
