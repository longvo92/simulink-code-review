/* generated by demo toolchain -- Tue Feb 17 2026 */ ASAP2_VERSION 1 71
/begin PROJECT Demo ""
/begin MODULE Ctrl ""
/begin MEASUREMENT EngSpd "engine speed" UWORD CM_EngSpd 1 100 0 8000 ECU_ADDRESS 0x40001000 /end MEASUREMENT
/begin MEASUREMENT VehSpd "vehicle speed" UWORD CM_VehSpd 1 100 0 300 ECU_ADDRESS 0x40001004 /end MEASUREMENT
/end MODULE
/end PROJECT
