AUTOSAR XML (schema 4.0)
package /Interfaces
  sender receiver interface If_Speed
    data Speed
  client server interface If_Diag
    operation ReadDtc
