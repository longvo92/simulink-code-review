/* generated by demo toolchain -- Mon Jan 05 2026 */ ASAP2_VERSION 1 71
/begin PROJECT Demo ""
/begin MODULE Ctrl ""
/begin MEASUREMENT EngSpd "engine speed" UWORD CM_EngSpd 1 100 0 8000 ECU_ADDRESS 0x40001000 /end MEASUREMENT
/begin CHARACTERISTIC K_Gain "controller gain" VALUE 0x80001000 __Scalar 100 CM_Gain 0 10 /end CHARACTERISTIC
/end MODULE
/end PROJECT
